## layers/meta-balena-dart-mx8m-plus/conf/layer.conf
```bitbake
BBPATH .= ":${LAYERDIR}"

BBFILES += "${LAYERDIR}/recipes-*/*/*.bb \
            ${LAYERDIR}/recipes-*/*/*.bbappend"

BBFILE_COLLECTIONS += "balena-dart-mx8m-plus"
BBFILE_PATTERN_balena-dart-mx8m-plus := "^${LAYERDIR}/"
BBFILE_PRIORITY_balena-dart-mx8m-plus = "1337"
LAYERSERIES_COMPAT_balena-dart-mx8m-plus = "kirkstone"
```

## layers/meta-balena-dart-mx8m-plus/conf/machine/bigmak-imx8m-plus.conf
```bitbake
#@TYPE: Machine
#@NAME: bigMak i.MX8M PLUS based on Variscite DART-MX8M-PLUS
#@SOC: i.MX8MP
#@DESCRIPTION: Machine configuration for bigMak i.MX8M PLUS based on Variscite DART-MX8M-PLUS

MACHINEOVERRIDES = "imx8mp-var-dart:${MACHINE}"
include conf/machine/imx8mp-var-dart.conf
```
